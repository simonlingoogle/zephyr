## CMakeLists.txt
```
# SPDX-License-Identifier: Apache-2.0

cmake_minimum_required(VERSION 3.20.0)
find_package(Zephyr REQUIRED HINTS $ENV{ZEPHYR_BASE})
project(sniff-to-shell)

target_sources(app PRIVATE src/main.c)
```

## sample.yaml
```
sample:
  name: IEEE 802.15.4 Packet Sniffer to Shell
  description: Capture and display IEEE 802.15.4 packets via shell interface
tests:
  sample.802154.sniff_to_shell:
    tags:
      - ieee802154
      - networking
      - shell
      - radio
    filter: dt_chosen_enabled("zephyr,ieee802154")
    depends_on: ieee802154
    harness: console
    timeout: 60
    integration_platforms:
      - nrf52840dongle_nrf52840
      - nrf52840dk_nrf52840
```

## prj.conf
```kconfig
# Logging
CONFIG_LOG=y
CONFIG_LOG_MODE_DEFERRED=y
CONFIG_LOG_DEFAULT_LEVEL=3

# Serial output
CONFIG_SERIAL=y
CONFIG_UART_CONSOLE=y
# Shell configurations
CONFIG_SHELL=y


# Random generator for MAC generation
CONFIG_TEST_RANDOM_GENERATOR=y

# 802.15.4 radio
CONFIG_IEEE802154=y
CONFIG_IEEE802154_RAW_MODE=y

# Networking core (minimal needed for net_pkt use)
CONFIG_NETWORKING=y
CONFIG_NET_PKT_RX_COUNT=6
CONFIG_NET_PKT_TX_COUNT=4
CONFIG_NET_BUF_DATA_SIZE=128

# Net logging
CONFIG_NET_LOG=y

# Channel and address config
CONFIG_NET_CONFIG_SETTINGS=y
CONFIG_NET_CONFIG_AUTO_INIT=n
CONFIG_NET_CONFIG_IEEE802154_CHANNEL=19

# Enable GPIO (if needed for LED/debug/etc)
CONFIG_GPIO=y

# Increase stack size if needed for heavy logging
CONFIG_MAIN_STACK_SIZE=2048
```

## src/main.c
```c
#include <zephyr/kernel.h>
#include <zephyr/device.h>
#include <zephyr/net/net_if.h>
#include <zephyr/net/net_pkt.h>
#include <zephyr/net/ieee802154_radio.h>
#include <zephyr/logging/log.h>
#include <zephyr/random/random.h>
#include <zephyr/shell/shell.h>
#include <zephyr/shell/shell_uart.h>
#include <stdio.h>

LOG_MODULE_REGISTER(wpan_sniffer, LOG_LEVEL_INF);

/* Use the default chosen 802.15.4 device */
static const struct device *radio_dev = DEVICE_DT_GET(DT_CHOSEN(zephyr_ieee802154));

static struct ieee802154_radio_api *radio_api;

static uint8_t mac_addr[8];

static uint8_t *get_mac(const struct device *dev)
{
	mac_addr[7] = 0x00;
	mac_addr[6] = 0x12;
	mac_addr[5] = 0x4b;
	mac_addr[4] = 0x00;

	sys_rand_get(mac_addr, 4U);

	mac_addr[0] = (mac_addr[0] & ~0x01) | 0x02;

	return mac_addr;
}

static bool init_radio(void)
{
	if (!device_is_ready(radio_dev)) {
		LOG_ERR("Radio device not ready");
		return false;
	}

	radio_api = (struct ieee802154_radio_api *)radio_dev->api;

	get_mac(radio_dev);

	if (IEEE802154_HW_FILTER & radio_api->get_capabilities(radio_dev)) {
		struct ieee802154_filter filter;

		filter.ieee_addr = mac_addr;
		radio_api->filter(radio_dev, true,
			IEEE802154_FILTER_TYPE_IEEE_ADDR, &filter);
	}

#ifdef CONFIG_NET_CONFIG_SETTINGS
	radio_api->set_channel(radio_dev, CONFIG_NET_CONFIG_IEEE802154_CHANNEL);
#endif

	radio_api->start(radio_dev);

	return true;
}

int net_recv_data(struct net_if *iface, struct net_pkt *pkt)
{
    const struct shell *sh = shell_backend_uart_get_ptr();
    int len = net_pkt_get_len(pkt);

    shell_print(sh, "Packet received: len=%d", len);

    struct net_buf *buf = net_buf_frag_last(pkt->buffer);
    uint8_t *data = buf->data;

    shell_fprintf(sh, SHELL_NORMAL, "Data [len=%d]: ", buf->len);
    for (int i = 0; i < MIN(buf->len, 16); i++) {
        shell_fprintf(sh, SHELL_NORMAL, "%02x ", data[i]);
    }
    shell_fprintf(sh, SHELL_NORMAL, "\n");

    net_pkt_unref(pkt);
    return 0;
}

enum net_verdict ieee802154_handle_ack(struct net_if *iface, struct net_pkt *pkt)
{
	return NET_CONTINUE;
}

int main(void)
{
	LOG_INF("Starting wpan sniffer app");

	if (!init_radio()) {
		LOG_ERR("Failed to initialize radio");
		return -1;
	}

	LOG_INF("Ready to receive packets");
	return 0;
}
```
